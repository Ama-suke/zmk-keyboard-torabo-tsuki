
#include "../../../config/keymap.keymap"
#include <input/processors.dtsi>

&trackball_listener {
    scroller {
        layers = <3>;
        input-processors = <&zip_xy_to_scroll_mapper>,
                            <&zip_scroll_scaler 1 20>,  // scale 1/20
                            <&zip_scroll_transform INPUT_TRANSFORM_Y_INVERT>; // swap y
    };
};
